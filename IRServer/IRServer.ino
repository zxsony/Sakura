/*
 * IRremoteESP8266: IRServer - demonstrates sending IR codes controlled from a webserver
 * Version 0.2 June, 2017
 * Copyright 2015 Mark Szabo
 *
 * An IR LED circuit *MUST* be connected to the ESP8266 on a pin
 * as specified by IR_LED below.
 *
 * TL;DR: The IR LED needs to be driven by a transistor for a good result.
 *
 * Suggested circuit:
 *     https://github.com/markszabo/IRremoteESP8266/wiki#ir-sending
 *
 * Common mistakes & tips:
 *   * Don't just connect the IR LED directly to the pin, it won't
 *     have enough current to drive the IR LED effectively.
 *   * Make sure you have the IR LED polarity correct.
 *     See: https://learn.sparkfun.com/tutorials/polarity/diode-and-led-polarity
 *   * Typical digital camera/phones can be used to see if the IR LED is flashed.
 *     Replace the IR LED with a normal LED if you don't have a digital camera
 *     when debugging.
 *   * Avoid using the following pins unless you really know what you are doing:
 *     * Pin 0/D3: Can interfere with the boot/program mode & support circuits.
 *     * Pin 1/TX/TXD0: Any serial transmissions from the ESP8266 will interfere.
 *     * Pin 3/RX/RXD0: Any serial transmissions to the ESP8266 will interfere.
 *   * ESP-01 modules are tricky. We suggest you use a module with more GPIOs
 *     for your first time. e.g. ESP-12 etc.
 */
#ifndef UNIT_TEST
#include <Arduino.h>
#endif
#include <ESP8266WiFi.h>
#include <ESP8266WebServer.h>
#include <ESP8266mDNS.h>
#include <IRremoteESP8266.h>
#include <IRsend.h>
#include <WiFiClient.h>

const char* ssid = "Tenda_FBA7C0";
const char* password = "121314150";
MDNSResponder mdns;

//uint16_t rawData[227];

ESP8266WebServer server(80);

#define IR_LED 12  // ESP8266 GPIO pin to use. Recommended: 4 (D2).

IRsend irsend(IR_LED);  // Set the GPIO to be used to sending the message.

void handleRoot() {
  server.send(200, "text/html",
              "<html>" \
                "<head><title>IR</title></head>" \
                "<body>" \
                  "<h1>Sakura" \
                      "</h1>" \

                  "<input style=\"width:200px;height:200px;font-size:48;\" type=\"button\" onclick=\"location.href='ir?code=1';\" value=\"On\" />" \
                  "<input style=\"width:200px;height:200px;font-size:48;\" type=\"button\" onclick=\"location.href='ir?code=2';\" value=\"Off\" />" \
                  "<input style=\"width:200px;height:200px;font-size:48;\" type=\"button\" onclick=\"location.href='ir?code=3';\" value=\"Sw On\" />" \
                  "<input style=\"width:200px;height:200px;font-size:48;\" type=\"button\" onclick=\"location.href='ir?code=4';\" value=\"Sw Off\" /><br />" \

                  "<input style=\"width:200px;height:200px;font-size:48;\" type=\"button\" onclick=\"location.href='ir?code=5';\" value=\"Cool\" />" \
                  "<input style=\"width:200px;height:200px;font-size:48;\" type=\"button\" onclick=\"location.href='ir?code=6';\" value=\"Low\" />" \
                  "<input style=\"width:200px;height:200px;font-size:48;\" type=\"button\" onclick=\"location.href='ir?code=7';\" value=\"Mid\" />" \
                  "<input style=\"width:200px;height:200px;font-size:48;\" type=\"button\" onclick=\"location.href='ir?code=8';\" value=\"High\" /><br />" \
                  
                  "<input style=\"width:200px;height:200px;font-size:48;\" type=\"button\" onclick=\"location.href='ir?code=22';\" value=\"22\" />" \
                  "<input style=\"width:200px;height:200px;font-size:48;\" type=\"button\" onclick=\"location.href='ir?code=23';\" value=\"23\" />" \
                  "<input style=\"width:200px;height:200px;font-size:48;\" type=\"button\" onclick=\"location.href='ir?code=24';\" value=\"24\" />" \
                  "<input style=\"width:200px;height:200px;font-size:48;\" type=\"button\" onclick=\"location.href='ir?code=25';\" value=\"25\" />" \
                  
                "</body>" \
              "</html>");
}

void handleIr() {
  for (uint8_t i = 0; i < server.args(); i++) {
    if (server.argName(i) == "code") {
      uint32_t code = strtoul(server.arg(i).c_str(), NULL, 10);
//#if SEND_NEC
//      irsend.sendNEC(code, 32);
//#endif  // SEND_NEC

      if(code == 1){
          uint16_t rawData[227] = {3076, 1630,  548, 1134,  540, 1142,  544, 362,  514, 400,  514, 354,  514,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 392,  514};  // UNKNOWN 6E94C72F
          irsend.sendRaw(rawData, 227, 38);
      }
        if(code == 2){
          uint16_t rawData[227] = {3080, 1626,  552, 1130,  544, 1138,  548, 332,  544, 396,  518, 322,  544,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 388,  514};  // UNKNOWN 39908069
          irsend.sendRaw(rawData, 227, 38);
      }
        if(code == 3){
          uint16_t rawData[227] = {3078, 1634,  544, 1160,  514, 1168,  514, 366,  514, 396,  514, 358,  514,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 392,  514};  // UNKNOWN C86A016D
          irsend.sendRaw(rawData, 227, 38);
      }
        if(code == 4){
          uint16_t rawData[227] = {3076, 1630,  544, 1160,  518, 1170,  514, 362,  514, 400,  514, 354,  514,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 392,  514};  // UNKNOWN 3634BC29
          irsend.sendRaw(rawData, 227, 38);
      }

        if(code == 5){
          uint16_t rawData[227] = {3076, 1630,  544, 1134,  544, 1142,  540, 362,  518, 396,  514, 352,  518,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 388,  514};  // UNKNOWN 6E94C72F
          irsend.sendRaw(rawData, 227, 38);
      }
        if(code == 6){
          uint16_t rawData[227] = {3082, 1630,  544, 1134,  540, 1142,  544, 362,  514, 400,  514, 352,  514,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 388,  514};  // UNKNOWN 6E94C72F
          irsend.sendRaw(rawData, 227, 38);
      }
        if(code == 7){
          uint16_t rawData[227] = {3078, 1630,  548, 1130,  544, 1142,  544, 362,  514, 396,  518, 348,  518,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 388,  518};  // UNKNOWN 61E995CF
          irsend.sendRaw(rawData, 227, 38);
      }
        if(code == 8){
          uint16_t rawData[227] = {3076, 1630,  544, 1134,  544, 1142,  540, 336,  544, 370,  540, 328,  540,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 1220,  514};  // UNKNOWN DD1ED62E
          irsend.sendRaw(rawData, 227, 38);
      }
      
        if(code == 22){
          uint16_t rawData[227] = {3080, 1626,  548, 1160,  512, 1174,  514, 362,  514, 400,  514, 354,  514,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 388,  514};  // UNKNOWN 3A81B38D
          irsend.sendRaw(rawData, 227, 38);
      }
        if(code == 23){
          uint16_t rawData[227] = {3106, 1604,  550, 1128,  570, 1116,  568, 306,  568, 344,  570, 322,  544,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 388,  514};  // UNKNOWN 9B4A5D4D
          irsend.sendRaw(rawData, 227, 38);
      }
        if(code == 24){
          uint16_t rawData[227] = {3106, 1604,  570, 1108,  544, 1138,  570, 336,  544, 340,  570, 328,  518,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 362,  514};  // UNKNOWN BC0203F
          irsend.sendRaw(rawData, 227, 38);
      }
        if(code == 25){
          uint16_t rawData[227] = {3102, 1608,  544, 1156,  518, 1168,  518, 362,  514, 396,  518, 352,  514,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 332,  574};  // UNKNOWN 96AB6EDD
          irsend.sendRaw(rawData, 227, 38);
      }
            
    }
  }
  handleRoot();
}

void handleNotFound() {
  String message = "File Not Found\n\n";
  message += "URI: ";
  message += server.uri();
  message += "\nMethod: ";
  message += (server.method() == HTTP_GET)?"GET":"POST";
  message += "\nArguments: ";
  message += server.args();
  message += "\n";
  for (uint8_t i = 0; i < server.args(); i++)
    message += " " + server.argName(i) + ": " + server.arg(i) + "\n";
  server.send(404, "text/plain", message);
}

void setup(void) {
  irsend.begin();

  Serial.begin(115200);
  WiFi.begin(ssid, password);
  Serial.println("");

  // Wait for connection
  while (WiFi.status() != WL_CONNECTED) {
    delay(500);
    Serial.print(".");
  }
  Serial.println("");
  Serial.print("Connected to ");
  Serial.println(ssid);
  Serial.print("IP address: ");
  Serial.println(WiFi.localIP().toString());

  if (mdns.begin("esp8266", WiFi.localIP())) {
    Serial.println("MDNS responder started");
  }

  server.on("/", handleRoot);
  server.on("/ir", handleIr);

  server.on("/inline", [](){
    server.send(200, "text/plain", "this works as well");
  });

  server.onNotFound(handleNotFound);

  server.begin();
  Serial.println("HTTP server started");
}

void loop(void) {
  server.handleClient();
}
